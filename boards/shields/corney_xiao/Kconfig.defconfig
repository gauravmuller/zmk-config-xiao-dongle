## boards/shields/corney_xiao/Kconfig.shield
```kconfig
config SHIELD_CORNEY_XIAO_LEFT
    def_bool $(shields_list_contains,corney_xiao_left)

config SHIELD_CORNEY_XIAO_RIGHT
    def_bool $(shields_list_contains,corney_xiao_right)
```

#include "corney_xiao.dtsi"

&kscan0 {
    col-gpios
        = <&gpio0 2 GPIO_ACTIVE_HIGH>  // col0 -> XIAO D0
        , <&gpio0 3 GPIO_ACTIVE_HIGH>  // col1 -> XIAO D1
        , <&gpio0 28 GPIO_ACTIVE_HIGH> // col2 -> XIAO D2
        , <&gpio0 29 GPIO_ACTIVE_HIGH> // col3 -> XIAO D3
        , <&gpio1 15 GPIO_ACTIVE_HIGH> // col4 -> XIAO D10
        , <&gpio0 9 GPIO_ACTIVE_HIGH>  // col5 -> XIAO NFC pad (P0.09)
        ;
};
